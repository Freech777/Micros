    LIST        P=16F877A
    #INCLUDE    <P16F877A.INC>

    __CONFIG    _XT_OSC & _WDT_OFF & _PWRTE_ON & _BODEN_OFF & _LVP_OFF & _CP_OFF

#DEFINE SPA     PORTA,0
#DEFINE SNA     PORTA,1
#DEFINE SB      PORTA,2

#DEFINE ML          PORTB,0
#DEFINE MS          PORTB,1
#DEFINE LED_PUERTA  PORTB,2
#DEFINE LED_LAVANDO PORTB,3
#DEFINE LED_LISTA   PORTB,4
#DEFINE LED_SECANDO PORTB,5
#DEFINE LED_ALARMA  PORTB,6

REPOSO      EQU     0
LAVANDO     EQU     1
LISTA_SECAR EQU     2
SECANDO     EQU     3
ALARMA      EQU     4

    CBLOCK  0x20
        ESTADO
        DELAY1
        DELAY2
        DELAY3
    ENDC

    ORG     0x00
    GOTO    INICIO

    ORG     0x04
    RETFIE

INICIO:
    BSF     STATUS,RP0

    MOVLW   0x07
    MOVWF   TRISA

    CLRF    TRISB

    MOVLW   0x06
    MOVWF   ADCON1

    BSF     OPTION_REG,7

    BCF     STATUS,RP0

    CLRF    PORTB

    MOVLW   REPOSO
    MOVWF   ESTADO

MAIN_LOOP
    MOVF    ESTADO,W

    XORLW   REPOSO
    BTFSC   STATUS,Z
    GOTO    ESTADO_REPOSO

    MOVF    ESTADO,W
    XORLW   LAVANDO
    BTFSC   STATUS,Z
    GOTO    ESTADO_LAVANDO

    MOVF    ESTADO,W
    XORLW   LISTA_SECAR
    BTFSC   STATUS,Z
    GOTO    ESTADO_LISTA_SECAR

    MOVF    ESTADO,W
    XORLW   SECANDO
    BTFSC   STATUS,Z
    GOTO    ESTADO_SECANDO

    MOVF    ESTADO,W
    XORLW   ALARMA
    BTFSC   STATUS,Z
    GOTO    ESTADO_ALARMA_LOOP

    GOTO    MAIN_LOOP


ESTADO_REPOSO
    MOVLW   b'00000100'
    MOVWF   PORTB

    BTFSC   SPA
    GOTO    MAIN_LOOP

    BTFSS   SNA
    GOTO    MAIN_LOOP

    MOVLW   LAVANDO
    MOVWF   ESTADO
    GOTO    MAIN_LOOP


ESTADO_LAVANDO
    MOVLW   b'00001001'
    MOVWF   PORTB


    BTFSS   SNA             
    GOTO    AGUA_DRENADA

    BTFSC   SPA             
    GOTO    IR_A_ALARMA
    GOTO    MAIN_LOOP

AGUA_DRENADA
    MOVLW   LISTA_SECAR
    MOVWF   ESTADO
    GOTO    MAIN_LOOP


ESTADO_LISTA_SECAR
    MOVLW   b'00010000'
    MOVWF   PORTB

    BTFSC   SPA             
    GOTO    MAIN_LOOP       

    CALL    RETARDO_5SEG

    BTFSC   SPA             
    GOTO    MAIN_LOOP       

    MOVLW   SECANDO
    MOVWF   ESTADO
    GOTO    MAIN_LOOP

ESPERAR_PUERTA:
    BTFSC   SPA             
    GOTO    ESPERAR_PUERTA

    CALL    RETARDO_5SEG

    MOVLW   SECANDO
    MOVWF   ESTADO
    GOTO    MAIN_LOOP


ESTADO_SECANDO:
    MOVLW   b'00100010'
    MOVWF   PORTB

    BTFSC   SB
    GOTO    IR_A_ALARMA

    BTFSC   SPA
    GOTO    IR_A_ALARMA

    GOTO    MAIN_LOOP


ESTADO_ALARMA_LOOP:
    MOVLW   b'01000000'
    MOVWF   PORTB
    GOTO    ESTADO_ALARMA_LOOP


IR_A_ALARMA:
    CLRF    PORTB
    BSF     LED_ALARMA
    MOVLW   ALARMA
    MOVWF   ESTADO
    GOTO    MAIN_LOOP

RETARDO_5SEG
    MOVLW   .25
    MOVWF   DELAY1
D1  
    MOVLW   .200
    MOVWF   DELAY2
D2  
    MOVLW   .250
    MOVWF   DELAY3
D3
    DECFSZ  DELAY3,F
    GOTO    D3
    DECFSZ  DELAY2,F
    GOTO    D2
    DECFSZ  DELAY1,F
    GOTO    D1
    RETURN

    END