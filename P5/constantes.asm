LIST P=16F877A
INCLUDE <P16F877A.INC>
__CONFIG  _XT_OSC & _WDT_OFF & _PWRTE_ON & _BODEN_OFF & _LVP_OFF

CBLOCK 0x20
    VAR_A
    VAR_B
    MENOR
    MAYOR
ENDC

ORG 0

BSF STATUS,RP0
CLRF TRISC      ; PORTC salida
CLRF TRISD      ; PORTD salida
BSF TRISB,7     ; RB7 entrada
BCF STATUS,RP0

MOVLW D'25'
MOVWF VAR_A

MOVLW D'100'
MOVWF VAR_B


MOVF VAR_A,W
SUBWF VAR_B,W       

BTFSC STATUS,C 
GOTO B_MAYOR

MOVF VAR_A,W
MOVWF MAYOR

MOVF VAR_B,W
MOVWF MENOR
GOTO CHECK_SWITCH

B_MAYOR
MOVF VAR_B,W
MOVWF MAYOR

MOVF VAR_A,W
MOVWF MENOR


CHECK_SWITCH
MAIN

    BTFSC PORTB,7   
    GOTO SWITCH_HIGH

LOW_STATE
    MOVF MENOR,W
    MOVWF PORTC

    MOVF MAYOR,W
    MOVWF PORTD

    GOTO MAIN

SWITCH_HIGH
    MOVF MENOR,W
    MOVWF PORTD

    MOVF MAYOR,W
    MOVWF PORTC

    GOTO MAIN

END